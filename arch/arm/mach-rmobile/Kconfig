## arch/arm/mach-rmobile/Kconfig
```kconfig
if ARCH_RMOBILE

choice
	prompt "Target Renesas SoC select"
	default RCAR_32

config RCAR_32
	bool "Renesas ARM SoCs R-Car Gen1/Gen2 (32bit)"
	select CPU_V7

config RCAR_GEN3
	bool "Renesas ARM SoCs R-Car Gen3 (64bit)"
	select ARM64

config RZA1
	prompt "Renesas ARM SoCs RZ/A1"
	select CPU_V7

config RZA2
	prompt "Renesas ARM SoCs RZ/A2"
	select CPU_V7

endchoice

source "arch/arm/mach-rmobile/Kconfig.32"
source "arch/arm/mach-rmobile/Kconfig.64"
source "arch/arm/mach-rmobile/Kconfig.rza1"

endif
```

## arch/arm/mach-rmobile/Kconfig.rza1
```kconfig
if RZA1

# required by the Ethernet driver
config R7S72100
	bool
	default y

# required by serial and usb driver
config CPU_RZA1
	bool
	default y

choice
	prompt "Renesas RZ/A1 board select"

# Renesas Supported Boards
config TARGET_RSKRZA1
	bool "RZ/A1H RSK board"
	select BOARD_LATE_INIT

# ENTER YOUR CUSTOM BOARD BELOW HERE TO AVOID MERGE CONFLICTS (TAG_TARGET)

endchoice

config SYS_SOC
	default "rmobile"

# Renesas Supported Boards
source "board/renesas/rskrza1/Kconfig"

# ENTER YOUR CUSTOM BOARD BELOW HERE TO AVOID MERGE CONFLICTS (TAG_KCONFIG)


endif
```

## board/renesas/rza1template/Kconfig
```kconfig
if TARGET_RZA1TEMPLATE

config SYS_BOARD
	default "rza1template"

config SYS_VENDOR
	default "companyname"

config SYS_CONFIG_NAME
	default "rza1template"

endif
```

## board/renesas/rza2mevb/Kconfig
```kconfig
if TARGET_RZA2MEVB

config SYS_BOARD
	default "rza2mevb"

config SYS_VENDOR
	default "renesas"

config SYS_CONFIG_NAME
	default "rza2mevb"

endif
```

## board/renesas/rza2template/Kconfig
```kconfig
if TARGET_RZATEMPLATE

config SYS_BOARD
	default "rzatemplate"

config SYS_VENDOR
	default "companyname"

config SYS_CONFIG_NAME
	default "rzatemplate"

endif
```

## configs/grpeach_defconfig
```kconfig
CONFIG_ARM=y
# CONFIG_SPL_SYS_THUMB_BUILD is not set
CONFIG_ARCH_RMOBILE=y
CONFIG_RZA1=y
CONFIG_TARGET_GRPEACH=y
CONFIG_BOOTDELAY=3
# CONFIG_CMD_ELF is not set
CONFIG_CMD_SF=y

CONFIG_CMD_USB=y
CONFIG_CMD_DHCP=y
CONFIG_CMD_MII=y
CONFIG_CMD_PING=y
CONFIG_CMD_SNTP=y
CONFIG_CMD_FAT=y
CONFIG_CMD_FS_GENERIC=y
CONFIG_MAC_PARTITION=y


CONFIG_SPI_FLASH=y
# CONFIG_SPI_FLASH_USE_4K_SECTORS is not set
CONFIG_SPI_SHOW_PROGRESS=y
CONFIG_RZ_SPI=y
CONFIG_USB=y
CONFIG_USB_STORAGE=y
CONFIG_OF_LIBFDT=y
CONFIG_OF_LIBFDT_OVERLAY=y
# CONFIG_EFI_LOADER is not set
# CONFIG_MMC is not set
# CONFIG_CMD_IMLS is not set
```

## configs/rskrza1_defconfig
```kconfig
CONFIG_ARM=y
# CONFIG_SYS_THUMB_BUILD is not set
CONFIG_ARCH_RMOBILE=y
CONFIG_RZA1=y
CONFIG_CMD_SF=y
CONFIG_CMD_I2C=y
CONFIG_CMD_USB=y
CONFIG_CMD_DHCP=y
CONFIG_CMD_MII=y
CONFIG_CMD_PING=y
CONFIG_CMD_SNTP=y
CONFIG_CMD_FAT=y
CONFIG_CMD_FS_GENERIC=y
CONFIG_MAC_PARTITION=y
CONFIG_RZA_RIIC=y
CONFIG_SPI_FLASH=y
# CONFIG_SPI_FLASH_USE_4K_SECTORS is not set
CONFIG_SPI_SHOW_PROGRESS=y
CONFIG_RZ_SPI=y
CONFIG_OF_LIBFDT=y
```

## configs/rza2template_defconfig
```kconfig
CONFIG_ARM=y
# CONFIG_SPL_SYS_THUMB_BUILD is not set
CONFIG_ARCH_RMOBILE=y
CONFIG_RZA2=y
CONFIG_TARGET_RZATEMPLATE=y
CONFIG_BOOTDELAY=3
# CONFIG_CMD_ELF is not set
CONFIG_CMD_SF=y
CONFIG_CMD_I2C=y
CONFIG_CMD_DHCP=y
CONFIG_CMD_MII=y
CONFIG_CMD_PING=y
CONFIG_CMD_SNTP=y
CONFIG_CMD_FAT=y
CONFIG_CMD_FS_GENERIC=y
CONFIG_MAC_PARTITION=y
CONFIG_RZA_RIIC=y
# CONFIG_MMC is not set
CONFIG_SPI_FLASH=y
# CONFIG_SPI_FLASH_USE_4K_SECTORS is not set
CONFIG_SPI_SHOW_PROGRESS=y
CONFIG_RZA2_QSPI=y
CONFIG_OF_LIBFDT=y
CONFIG_OF_LIBFDT_OVERLAY=y
# CONFIG_EFI_LOADER is not set
```
